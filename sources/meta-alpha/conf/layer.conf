## sources/meta-alpha/conf/layer.conf
```bitbake
# We have a conf and classes directory, add to BBPATH
BBPATH .= ":${LAYERDIR}"

# We have recipes-* directories, add to BBFILES
BBFILES += "${LAYERDIR}/recipes-*/*/*.bb \
            ${LAYERDIR}/recipes-*/*/*.bbappend"

BBFILE_COLLECTIONS += "meta-alpha"
BBFILE_PATTERN_meta-alpha = "^${LAYERDIR}/"
# Layer 优先级（值越大优先级越高，默认 6 即可，避免覆盖基础层） 这里设为 9
BBFILE_PRIORITY_meta-alpha = "9"

LAYERDEPENDS_meta-alpha = "core"
LAYERSERIES_COMPAT_meta-alpha = "scarthgap"

#  Layer 版本（自定义，如 1.0）
LAYERVERSION = "1.0"

# 6. Layer 描述（自定义）
LAYERDESCRIPTION = "Custom Layer for My Machine (e.g., ARM-based board)"
```

## sources/meta-alpha/conf/machine/imx6ull14x14alpha.conf
```bitbake
#@TYPE: Machine
#@NAME: NXP i.MX6ULL 14x14 Evaluation Kit
#@SOC: i.MX6ULL
#@DESCRIPTION: Machine configuration for NXP i.MX6ULL 14x14 EVK
#@MAINTAINER: Lauren Post <lauren.post@nxp.com>

MACHINEOVERRIDES =. "mx6:mx6ul:mx6ull:"

include conf/machine/include/imx-base.inc
include conf/machine/include/arm/armv7a/tune-cortexa7.inc

PREFERRED_VERSION_qemu = "8.2.7"
PREFERRED_VERSION_qemu-native = "8.2.7"
PREFERRED_VERSION_nativesdk-qemu = "8.2.7"

# 选择 U-Boot 配置文件
UBOOT_MACHINE = "mx6ull_14x14_alpha_emmc_defconfig"

KERNEL_DEVICETREE = "nxp/imx/imx6ull-14x14-alpha-emmc.dtb"
KBUILD_DEFCONFIG = "imx6ull_14x14_alpha_emmc_defconfig"

MACHINE_FEATURES:remove = "optee "
```
